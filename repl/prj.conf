## CMakeLists.txt
```
# SPDX-License-Identifier: MIT
cmake_minimum_required(VERSION 3.20.0)

find_package(Zephyr REQUIRED HINTS $ENV{ZEPHYR_BASE})
project(mu_lambda C)

target_include_directories(app PRIVATE include)

file(GLOB app_sources CONFIGURE_DEPENDS ${CMAKE_CURRENT_SOURCE_DIR}/src/*.c)
target_sources(app PRIVATE ${app_sources})
```

## prj.conf
```kconfig
CONFIG_SERIAL=y
CONFIG_CONSOLE=y
CONFIG_UART_CONSOLE=y
CONFIG_CONSOLE_HANDLER=y
CONFIG_UART_CONSOLE_DEBUG_SERVER_HOOKS=y
CONFIG_SHELL=n
CONFIG_MAIN_STACK_SIZE=12288
CONFIG_I2C=y
CONFIG_HEAP_MEM_POOL_SIZE=0
```

## boards/esp32s3_devkitc.overlay
```dts
&gpio0 {
	label = "gpio0";
};

&gpio1 {
	label = "gpio1";
};
```

## boards/nucleo_f429zi.overlay
```dts
&i2c1 {
    label = "i2c1";
    status = "okay";
};

/* The user button B1 sits on PC13, gpioRead finds the port by this label */
&gpioc {
    label = "gpioc";
    status = "okay";
};
```

## src/main.c
```c
#include <stdbool.h>
#include <stdio.h>
#include <string.h>

#include "mu_arena.h"
#include "mu_console.h"
#include "mu_read.h"
#include "interpreter.h"
#include "builtins.h"

#define LINE_MAX  128
#define STMT_MAX  4096
#define BANNER    "μλ REPL\r\n"
#define BATCH_MSG "batch mode, ctrl d to run\r\n"
#define SEP_IN    "=============== input ===============\r\n"
#define SEP_OUT   "=============== output ==============\r\n"
#define SEP_END   "================ end ================\r\n"
/* Put the terminal back the way it was found: default colours, cursor on */
#define TERM_RESET "\x1b[0m\x1b[?25h"
#define RESET_MSG "session cleared\r\n"

/* Buffer uses \n between lines, terminal needs \r\n */
static void mu_print(const char* s, size_t len) {
    size_t start = 0;

    for (size_t i = 0; i < len; i++) {
        if (s[i] == '\n') {
            mu_write(s + start, i - start);
            mu_write("\r\n", 2);
            start = i + 1;
        }
    }

    mu_write(s + start, len - start);
}

/* Ending a line with ':' will start writing a block, 'enter' on an empty line
 * ends the block */
static bool opens_block(const char* s, size_t len) {
    while (len > 0 && (s[len - 1] == ' ' || s[len - 1] == '\t')) {
        len--;
    }

    return len > 0 && s[len - 1] == ':';
}

static env_t* fresh_env(void) {
    env_t* env = create_env(NULL);

    if (!env) {
        return NULL;
    }

    register_builtin(env, "print", builtin_print);
    register_builtin(env, "write", builtin_write);
    register_builtin(env, "halt", builtin_halt);
    register_builtin(env, "reset", builtin_reset);
    register_builtin(env, "sleep", builtin_sleep);
    register_builtin(env, "gpioSet", builtin_gpio_set);
    register_builtin(env, "gpioRead", builtin_gpio_read);
    register_builtin(env, "i2cRegWrite", builtin_i2c_reg_write);
    register_builtin(env, "i2cRegRead", builtin_i2c_reg_read);

    return env;
}

int main(void) {
    static char line[LINE_MAX];
    static char stmt[STMT_MAX];

    if (mu_console_init() < 0) {
        return -1;
    }

    mu_arena_init();

    env_t* env = fresh_env();
    if (!env) {
        return -1;
    }

    mu_write(BANNER, sizeof(BANNER) - 1);

    for (;;) {
        const char* prompt = ">>> ";
        size_t len = 0;
        bool block = false;
        bool batch = false;

        stmt[0] = '\0';

        for (;;) {
            int n = mu_readline(line, sizeof(line), prompt);

            // Ctrl e, keep collecting lines until ctrl d
            if (n == MU_LINE_BATCH) {
                // Ignore it if already in batch mode
                if (!batch) {
                    mu_write(BATCH_MSG, sizeof(BATCH_MSG) - 1);
                    mu_write(SEP_IN, sizeof(SEP_IN) - 1);
                    batch = true;
                    prompt = "";
                }
                continue;
            }

            // Ctrl d, end batch mode
            if (n == MU_LINE_EOF) {
                break;
            }

            // Ctrl c or bad args
            if (n < 0) {
                len = 0;
                break;
            }

            // blank line, close the open block
            if (block && !batch && n == 0) {
                break;
            }

            if (len + n + 2 > sizeof(stmt)) {
                mu_write("too long\r\n", 10);
                len = 0;
                break;
            }

            memcpy(stmt + len, line, n);
            len += n;
            stmt[len] = '\0';

            if (opens_block(line, n)) {
                block = true;
            }

            if (!block && !batch) {
                break;
            }

            stmt[len++] = '\n';
            stmt[len] = '\0';

            if (!batch) {
                prompt = "... ";
            }
        }

        // if nothing typed
        if (len == 0) {
            continue;
        }

        if (batch) {
            mu_write(SEP_OUT, sizeof(SEP_OUT) - 1);
        }

        // Scratch only holds the token list, it never outlives a submission
        memrina_clear(mu_scratch);

        // Rewind point for a submission that turns out to define nothing
        Memrina_Checkpoint cp = memrina_set_check(mu_session);
        int bindings_before = env->count;

        // Source has to outlive the call, tokens point into it
        char* src = memrina_strndup(mu_session, stmt, len);
        if (!src) {
            mu_write("out of memory\r\n", 16);
            continue;
        }

        value_t* result = run_interpreter(src, env);

        /* A program that set colours or hid the cursor may have been cut off
         * before it could undo either, so the prompt never inherits them. */
        mu_write(TERM_RESET, sizeof(TERM_RESET) - 1);

        if (result) {
            if (result->valueType == VAR_INT) {
                char buf[16];
                int n = snprintf(buf, sizeof(buf), "%d", result->value.integer);
                mu_write(buf, n);
                mu_write("\r\n", 2);
            } else if (result->valueType == VAR_STRING) {
                mu_write(result->value.string, strlen(result->value.string));
                mu_write("\r\n", 2);
            }
        }

        /* Keep a submission only if it ran to the end and defined something.
         * An interrupt or an error rolls the whole thing back, dropping its
         * half made definitions along with everything it allocated, so the
         * next one starts from exactly where this one did. */
        if (mu_reset_requested()) {
            // Safe now that evaluation has unwound and nothing points into it
            memrina_clear(mu_session);
            env = fresh_env();

            if (!env) {
                return -1;
            }

            mu_write(RESET_MSG, sizeof(RESET_MSG) - 1);
        } else if (!result || env->count == bindings_before) {
            env_truncate(env, bindings_before);
            memrina_restore_check(mu_session, cp);
        }

        if (batch) {
            mu_write(SEP_END, sizeof(SEP_END) - 1);
        }
    }
}
```

## include/builtins.h
```c
#ifndef __BUILTINS_H
#define __BUILTINS_H

#include "interpreter.h"

value_t* builtin_print(value_t* arg);
value_t* builtin_write(value_t* arg);
value_t* builtin_halt(value_t* arg);
value_t* builtin_reset(value_t* arg);
value_t* builtin_sleep(value_t* arg);
value_t* builtin_gpio_set(value_t* arg);
value_t* builtin_gpio_read(value_t* arg);
value_t* builtin_i2c_reg_write(value_t* arg);
value_t* builtin_i2c_reg_read(value_t* arg);
void register_builtin(env_t* env, const char* name, builtin_fn fn);

#endif
```

## include/interpreter.h
```c
#ifndef INTERPRETER_H_
#define INTERPRETER_H_

#include "parser.h"

#define MU_BINDING_ERR    -1
#define MU_SUCCESS        0
#define SCOPED_CASE(name) case name: {
#define END_SCOPE         }

typedef enum value_type {
    VAR_UNKNOWN,
    VAR_INT,
    VAR_STRING,
    VAR_LIST,
    VAR_NORESULT,
    VAR_CLOSURE,
    VAR_BUILTIN,
    VAR_NATIVE_CLOSURE,
    VAR_THUNK,
    VAR_ERROR
} value_type_t;

typedef struct value value_t;
typedef struct binding binding_t;
typedef value_t* (*builtin_fn)(value_t* arg);
typedef value_t* (*native_closure_fn)(void* ctx, value_t* arg);

struct binding {
    char* name;
    value_t* value;
    binding_t* next;
};

typedef struct env {
    struct env* parent;
    binding_t* bindings;
    int count;
    int refcount;
} env_t;

typedef struct closure {
    ast_node_t* params;
    ast_node_t* body;
    env_t* env;
    int tailcall;
} closure_t;

typedef struct thunk {
    value_t* fn;
    value_t* arg;
} thunk_t;

typedef struct native_closure {
    native_closure_fn fn;
    void* ctx;
} native_closure_t;

struct value {
    value_type_t valueType;
    int is_return;
    int refcount;
    union {
        int integer;
        char* string;
        closure_t closure;
        thunk_t thunk;
        builtin_fn builtin;
        native_closure_t native;
    } value;
};

env_t* create_env(env_t* parent);
int create_binding(env_t* env, char* name, int nameLen, value_t* value);
void mu_halt(void);
void mu_request_reset(void);
bool mu_reset_requested(void);
void env_truncate(env_t* env, int count);
value_t* env_lookup(env_t* env, char* name, int nameLen);
value_t* evaluate(ast_node_t* node, env_t* env);
value_t* evaluate_tc(ast_node_t* node, env_t* env, int in_tailcall);
void register_builtin(env_t* env, const char* name, builtin_fn fn);
value_t* run_interpreter(char* source, env_t* env);
value_t* make_no_result();
value_t* make_error();
value_t* make_int(int val);

#endif
```

## include/memory-arena.h
```c
#ifndef MEMORY_ARENA_H
#define MEMORY_ARENA_H

#include <stddef.h>
#include <stdint.h>

/*No individual free, you either create a checkpoint that
you  can rewind to for temporary values or you clear the whole thing*/

typedef struct {
    uint8_t* base; // start of the memory block
    size_t size;   // size of the memory arena
    size_t offset; // current position in memory arena (bytes used)
} Memrina;

/*checkpoint which you can rewind to */

typedef struct {
    size_t offset;
} Memrina_Checkpoint;

/* Default alignment used by arena_alloc(). Override with arena_alloc_aligned()
for special cases.  */
#define MEMRINA_DEFAULT_ALIGNMENT (sizeof(void*))

// allocate memory and create memory arena
Memrina* memrina_create(size_t size);

// free allocated memory from arena
void memrina_destroy(Memrina* arena);

// initialise memory arena
void memrina_init(Memrina* arena, uint8_t* buffer, size_t size);

// allocates nbytes aligned to alignment (must be a power of two)
void* memrina_alloc_aligned(Memrina* arena, size_t nbytes, size_t alignment);

// allocates nbytes aligned to the default alignment. Returns NULL on
// out-of-memory
void* memrina_alloc(Memrina* arena, size_t nbytes);

// zero-initialized allocation like calloc
void* memrina_calloc(Memrina* arena, size_t nbytes);

// allocates count items of size bytes each, returns NULL if the multiply would overflow
void* memrina_alloc_array(Memrina* arena, size_t count, size_t size);

// copies nbytes from src into the arena
void* memrina_memdup(Memrina* arena, const void* src, size_t nbytes);

// copies len bytes of src into the arena and null terminates it
char* memrina_strndup(Memrina* arena, const char* src, size_t len);

// take a checkpoint of the current memory block
Memrina_Checkpoint memrina_set_check(Memrina* arena);

/* restore arena to previous checkpoint, freeing everything allocated since.
Must be called with checkpoint from same arena */
void memrina_restore_check(Memrina* arena, Memrina_Checkpoint checkpoint);

// free everything at once, does not zero the memory.
void memrina_clear(Memrina* arena);

// returns bytes currently in use
size_t memrina_usage(Memrina* arena);

// returns bytes currently free
size_t memrina_remaining(Memrina* arena);

#endif
```

## include/mu_arena.h
```c
#ifndef MU_ARENA_H
#define MU_ARENA_H

#include "memory-arena.h"

// Lives until soft reset, holds source, AST, environments, bindings and values
extern Memrina* mu_session;

// Cleared before every submission, holds the token list and scratch work
extern Memrina* mu_scratch;

// Sets up both arenas over their static buffers, call once at startup
void mu_arena_init(void);

#endif
```

## include/mu_console.h
```c
#ifndef MU_CONSOLE_H
#define MU_CONSOLE_H

#include <stdbool.h>
#include <stddef.h>

int mu_console_init(void);

int mu_getchar(void);

void mu_putchar(char c);
void mu_write(const char* s, size_t len);

bool mu_interrupted(void);

bool mu_dropped(void);

#endif
```

## include/mu_read.h
```c
#ifndef MU_READ_H
#define MU_READ_H

#include <stddef.h>

#define MU_LINE_CANCELLED (-1) /* ctrl c */
#define MU_LINE_ERROR     (-2) /* bad args or console failure */
#define MU_LINE_EOF       (-3) /* ctrl d, ends batch mode */
#define MU_LINE_BATCH     (-4) /* ctrl e, starts batch mode */

int mu_readline(char* buf, size_t cap, const char* prompt);

#endif
```

## include/parser.h
```c
#ifndef PARSER_H_
#define PARSER_H_

#include <stdbool.h>

#include "tokeniser.h"

typedef enum node_type_t {
    NODE_INT,
    NODE_STR,
    NODE_VAR,
    NODE_BINOP,
    NODE_NEG,
    NODE_COMP,
    NODE_ASSIGN,
    NODE_IF,
    NODE_FN,
    NODE_LAMBDA,
    NODE_APPLY,
    NODE_RETURN,
    NODE_TAILCALL,
    NODE_BLOCK,
    NODE_ENTRY,
    NODE_ERROR // stands in for a construct the parser couldn't make sense of;
               // holds the offending token so the tree can be walked to
               // find every parse error in one pass
} node_type_t;

typedef struct ASTNode {
    node_type_t type;
    token_t token;
    struct ASTNode* left;
    struct ASTNode* right;
    struct ASTNode* cond;
} ast_node_t;

typedef struct Parser {
    token_t* tokens;
    int pos;
    bool error; // set once any parse error has been recorded; the AST may
                // still be walked (NODE_ERROR nodes mark where), but the
                // caller should not run it through the interpreter
} parser_t;

parser_t parser_init(token_t* tokens);
// token_t parser_current(parser_t* p);
// token_t parser_advance(parser_t* p);
// token_t parser_match(parser_t* p, atomic_token_t type);
// void parser_skip_newlines(parser_t* p);

ast_node_t* parse_program(parser_t* p);
ast_node_t* parse_block(parser_t* p);
ast_node_t* parse_statement(parser_t* p);
ast_node_t* parse_if(parser_t* p);
ast_node_t* parse_fn(parser_t* p, int tailcall);
ast_node_t* parse_lambda(parser_t* p);
ast_node_t* parse_expr_statement(parser_t* p);
ast_node_t* parse_comparison(parser_t* p);
ast_node_t* parse_term(parser_t* p);
ast_node_t* parse_factor(parser_t* p);
ast_node_t* parse_bitwise(parser_t* p);
ast_node_t* parse_call(parser_t* p);
ast_node_t* parse_atomic(parser_t* p);

void ast_free(ast_node_t* node);

#endif
```

## include/tokeniser.h
```c
#ifndef TOKENISER_H_
#define TOKENISER_H_

#define UPDATE_TOKEN(type, s, size)                                                                \
    do {                                                                                           \
        token.token = type;                                                                        \
        token.str = s;                                                                             \
        token.len = size;                                                                          \
    } while (0)

typedef enum atomic_token_t {
    // File stuff
    TOKEN_ERR,
    TOKEN_EOF,
    TOKEN_NEWLINE,
    TOKEN_UNUSED,
    // Types
    TOKEN_INT,
    TOKEN_STR,
    TOKEN_IDENTIFIER,
    // BitWise 
    TOKEN_COMPLIMENT,
    TOKEN_OR,
    TOKEN_AND,
    TOKEN_XOR,
    TOKEN_LSHIFT,
    TOKEN_RSHIFT,
    // Arithmitic
    TOKEN_PLUS,
    TOKEN_MINUS,
    TOKEN_TIMES,
    TOKEN_DIVIDE,
    TOKEN_MODULO,
    // Comparision
    TOKEN_GREATERTHAN,
    TOKEN_GREATERTHANEQUAL,
    TOKEN_LESSTHAN,
    TOKEN_LESSTHANEQUAL,
    TOKEN_EQUALTO,
    TOKEN_NOTEQUALTO,
    // Keywords
    TOKEN_IF,
    TOKEN_ELSE,
    TOKEN_ASSIGNMENT,
    TOKEN_LAMBDA,
    TOKEN_FUNCTION,
    TOKEN_TAILCALL,
    TOKEN_RETURN,
    TOKEN_ARROW,
    TOKEN_COLON,
    TOKEN_COMMENT,
    TOKEN_OPENPAREN,
    TOKEN_CLOSEPAREN,
    TOKEN_END,
    TOKEN_ENTRYPOINT
} atomic_token_t;

typedef struct Token {
    atomic_token_t token;
    int len;
    char* str;
} token_t;

token_t tokenise(char** str);

token_t* get_token_list(char** str);

#endif
```

## src/builtins.c
```c
#include <stdio.h>

#include <zephyr/kernel.h>
#include <zephyr/drivers/gpio.h>
#include <zephyr/drivers/i2c.h>
#include "interpreter.h"
#include "zephyr/dt-bindings/gpio/gpio.h"
#include "builtins.h"
#include "mu_arena.h"
#include "mu_console.h"

#define BUILTIN_ERR(name)                                                                          \
    do {                                                                                           \
        printk("[!] Error: " name " syntax error\n");                                              \
        return make_error();                                                                       \
    } while (0)

/* printk opens every call with its own colour escape, which would wipe out any
 * colour a program sets, so program output goes straight to the console. The
 * buffer uses \n between lines and the terminal needs \r\n. */
static void console_str(const char* s) {
    size_t start = 0;
    size_t i = 0;

    for (; s[i] != '\0'; i++) {
        if (s[i] == '\n') {
            mu_write(s + start, i - start);
            mu_write("\r\n", 2);
            start = i + 1;
        }
    }

    mu_write(s + start, i - start);
}

static int console_value(value_t* arg) {
    if (!arg) {
        return 0;
    }

    if (arg->valueType == VAR_INT) {
        char buf[16];
        int n = snprintf(buf, sizeof(buf), "%d", arg->value.integer);

        if (n > 0) {
            mu_write(buf, (size_t)n);
        }

        return 1;
    }

    if (arg->valueType == VAR_STRING) {
        console_str(arg->value.string);
        return 1;
    }

    return 0;
}

value_t* builtin_print(value_t* arg) {
    if (!console_value(arg)) {
        BUILTIN_ERR("print");
    }

    mu_write("\r\n", 2);

    return make_no_result();
}

// Same as print but leaves the cursor where it is, for escapes and partial lines
value_t* builtin_write(value_t* arg) {
    if (!console_value(arg)) {
        BUILTIN_ERR("write");
    }

    return make_no_result();
}

/* Stop the program where it stands. Takes an argument it ignores, since a
 * function with no parameters cannot be called. */
value_t* builtin_halt(value_t* arg) {
    (void)arg;

    mu_halt();

    return make_error();
}

/* Throw away every definition and hand the whole arena back */
value_t* builtin_reset(value_t* arg) {
    (void)arg;

    mu_request_reset();

    return make_error();
}

value_t* builtin_sleep(value_t* arg) {
    if (!arg || arg->valueType != VAR_INT) {
        BUILTIN_ERR("sleep");
    }

    k_msleep(arg->value.integer);
    return make_no_result();
}

typedef struct {
    const struct device* gpio;
    int pin;
} gpio_ctx_t;

static value_t* gpio_set_value(void* ctx, value_t* arg) {
    if (!arg || arg->valueType != VAR_INT) {
        BUILTIN_ERR("gpioSet");
    }

    gpio_ctx_t* g = (gpio_ctx_t*)ctx;

    // TODO: Don't enforce PULL_UP, let user decide
    gpio_pin_configure(g->gpio, g->pin, GPIO_OUTPUT | GPIO_PULL_UP);
    gpio_pin_set(g->gpio, g->pin, arg->value.integer);

    return make_no_result();
}

static value_t* gpio_set_pin(void* ctx, value_t* arg) {
    if (!arg || arg->valueType != VAR_INT) {
        BUILTIN_ERR("gpioSet");
    }

    gpio_ctx_t* g = (gpio_ctx_t*)ctx;

    gpio_ctx_t* next = (gpio_ctx_t*)memrina_alloc(mu_session, sizeof(gpio_ctx_t));
    if (!next) {
        return NULL;
    }

    next->gpio = g->gpio;
    next->pin = arg->value.integer;

    value_t* val = (value_t*)memrina_alloc(mu_session, sizeof(value_t));
    if (!val) {
        return NULL;
    }

    val->valueType = VAR_NATIVE_CLOSURE;
    val->is_return = 0;
    val->refcount = 1;
    val->value.native.fn = gpio_set_value;
    val->value.native.ctx = next;

    return val;
}

value_t* builtin_gpio_set(value_t* arg) {
    if (!arg || arg->valueType != VAR_STRING) {
        BUILTIN_ERR("gpioSet");
    }

    const struct device* gpio = device_get_binding(arg->value.string);
    if (!gpio || !device_is_ready(gpio)) {
        printk("[!] Error: gpioSet device '%s' not ready\n", arg->value.string);
        return make_error();
    }

    gpio_ctx_t* ctx = (gpio_ctx_t*)memrina_alloc(mu_session, sizeof(gpio_ctx_t));
    if (!ctx) {
        return NULL;
    }

    ctx->gpio = gpio;
    ctx->pin = -1;

    value_t* val = (value_t*)memrina_alloc(mu_session, sizeof(value_t));
    if (!val) {
        return NULL;
    }

    val->valueType = VAR_NATIVE_CLOSURE;
    val->is_return = 0;
    val->refcount = 1;
    val->value.native.fn = gpio_set_pin;
    val->value.native.ctx = ctx;

    return val;
}

static value_t* gpio_read_pin(void* ctx, value_t* arg) {
    if (!arg || arg->valueType != VAR_INT) {
        BUILTIN_ERR("gpioRead");
    }

    gpio_ctx_t* g = (gpio_ctx_t*)ctx;
    gpio_pin_configure(g->gpio, arg->value.integer, GPIO_INPUT);
    int val = gpio_pin_get(g->gpio, arg->value.integer);

    return make_int(val);
}

value_t* builtin_gpio_read(value_t* arg) {
    if (!arg || arg->valueType != VAR_STRING) {
        BUILTIN_ERR("gpioRead");
    }

    const struct device* gpio = device_get_binding(arg->value.string);
    if (!gpio || !device_is_ready(gpio)) {
        printk("[!] Error: gpioRead device '%s' not ready\n", arg->value.string);
        return make_error();
    }

    gpio_ctx_t* ctx = (gpio_ctx_t*)memrina_alloc(mu_session, sizeof(gpio_ctx_t));
    if (!ctx) {
        return NULL;
    }

    ctx->gpio = gpio;
    ctx->pin = -1;

    value_t* val = (value_t*)memrina_alloc(mu_session, sizeof(value_t));
    if (!val) {
        return NULL;
    }

    val->valueType = VAR_NATIVE_CLOSURE;
    val->is_return = 0;
    val->refcount = 1;
    val->value.native.fn = gpio_read_pin;
    val->value.native.ctx = ctx;

    return val;
}

typedef struct {
    const struct device* i2c;
    uint16_t addr;
    uint8_t reg;
} i2c_reg_ctx_t;

static value_t* i2c_reg_write_val(void* ctx, value_t* arg) {
    if (!arg || arg->valueType != VAR_INT) {
        BUILTIN_ERR("i2cRegWrite");
    }

    i2c_reg_ctx_t* c = (i2c_reg_ctx_t*)ctx;
    uint8_t buf[2] = { c->reg, (uint8_t)arg->value.integer };

    int ret = i2c_write(c->i2c, buf, 2, c->addr);
    if (ret < 0) {
        printk("[!] Error: i2cRegWrite failed (%d)\n", ret);
        return make_error();
    }

    return make_no_result();
}

static value_t* i2c_reg_write_reg(void* ctx, value_t* arg) {
    if (!arg || arg->valueType != VAR_INT) {
        BUILTIN_ERR("i2cRegWrite");
    }

    i2c_reg_ctx_t* prev = (i2c_reg_ctx_t*)ctx;

    i2c_reg_ctx_t* next = (i2c_reg_ctx_t*)memrina_alloc(mu_session, sizeof(i2c_reg_ctx_t));
    if (!next) {
        return NULL;
    }

    next->i2c = prev->i2c;
    next->addr = prev->addr;
    next->reg = (uint8_t)arg->value.integer;

    value_t* val = (value_t*)memrina_alloc(mu_session, sizeof(value_t));
    if (!val) {
        return NULL;
    }

    val->valueType = VAR_NATIVE_CLOSURE;
    val->is_return = 0;
    val->refcount = 1;
    val->value.native.fn = i2c_reg_write_val;
    val->value.native.ctx = next;

    return val;
}

static value_t* i2c_reg_write_addr(void* ctx, value_t* arg) {
    if (!arg || arg->valueType != VAR_INT) {
        BUILTIN_ERR("i2cRegWrite");
    }

    i2c_reg_ctx_t* prev = (i2c_reg_ctx_t*)ctx;

    i2c_reg_ctx_t* next = (i2c_reg_ctx_t*)memrina_alloc(mu_session, sizeof(i2c_reg_ctx_t));
    if (!next) {
        return NULL;
    }

    next->i2c = prev->i2c;
    next->addr = (uint16_t)arg->value.integer;
    next->reg = 0;

    value_t* val = (value_t*)memrina_alloc(mu_session, sizeof(value_t));
    if (!val) {
        return NULL;
    }

    val->valueType = VAR_NATIVE_CLOSURE;
    val->is_return = 0;
    val->refcount = 1;
    val->value.native.fn = i2c_reg_write_reg;
    val->value.native.ctx = next;

    return val;
}

value_t* builtin_i2c_reg_write(value_t* arg) {
    if (!arg || arg->valueType != VAR_STRING) {
        BUILTIN_ERR("i2cRegWrite");
    }

    const struct device* i2c = device_get_binding(arg->value.string);
    if (!i2c || !device_is_ready(i2c)) {
        printk("[!] Error: i2cRegWrite device '%s' not ready\n", arg->value.string);
        return make_error();
    }

    i2c_reg_ctx_t* ctx = (i2c_reg_ctx_t*)memrina_alloc(mu_session, sizeof(i2c_reg_ctx_t));
    if (!ctx) {
        return NULL;
    }

    ctx->i2c = i2c;
    ctx->addr = 0;
    ctx->reg = 0;

    value_t* val = (value_t*)memrina_alloc(mu_session, sizeof(value_t));
    if (!val) {
        return NULL;
    }

    val->valueType = VAR_NATIVE_CLOSURE;
    val->is_return = 0;
    val->refcount = 1;
    val->value.native.fn = i2c_reg_write_addr;
    val->value.native.ctx = ctx;

    return val;
}

static value_t* i2c_reg_read_reg(void* ctx, value_t* arg) {
    if (!arg || arg->valueType != VAR_INT) {
        BUILTIN_ERR("i2cRegRead");
    }

    i2c_reg_ctx_t* c = (i2c_reg_ctx_t*)ctx;
    uint8_t reg = (uint8_t)arg->value.integer;
    uint8_t byte = 0;

    int ret = i2c_reg_read_byte(c->i2c, c->addr, reg, &byte);
    if (ret < 0) {
        printk("[!] Error: i2cRegRead failed (%d)\n", ret);
        return make_error();
    }

    return make_int((int)byte);
}

static value_t* i2c_reg_read_addr(void* ctx, value_t* arg) {
    if (!arg || arg->valueType != VAR_INT) {
        BUILTIN_ERR("i2cRegRead");
    }

    i2c_reg_ctx_t* prev = (i2c_reg_ctx_t*)ctx;

    i2c_reg_ctx_t* next = (i2c_reg_ctx_t*)memrina_alloc(mu_session, sizeof(i2c_reg_ctx_t));
    if (!next) {
        return NULL;
    }

    next->i2c = prev->i2c;
    next->addr = (uint16_t)arg->value.integer;
    next->reg = 0;

    value_t* val = (value_t*)memrina_alloc(mu_session, sizeof(value_t));
    if (!val) {
        return NULL;
    }

    val->valueType = VAR_NATIVE_CLOSURE;
    val->is_return = 0;
    val->refcount = 1;
    val->value.native.fn = i2c_reg_read_reg;
    val->value.native.ctx = next;

    return val;
}

value_t* builtin_i2c_reg_read(value_t* arg) {
    if (!arg || arg->valueType != VAR_STRING) {
        BUILTIN_ERR("i2cRegRead");
    }

    const struct device* i2c = device_get_binding(arg->value.string);
    if (!i2c || !device_is_ready(i2c)) {
        printk("[!] Error: i2cRegRead device '%s' not ready\n", arg->value.string);
        return make_error();
    }

    i2c_reg_ctx_t* ctx = (i2c_reg_ctx_t*)memrina_alloc(mu_session, sizeof(i2c_reg_ctx_t));
    if (!ctx) {
        return NULL;
    }

    ctx->i2c = i2c;
    ctx->addr = 0;
    ctx->reg = 0;

    value_t* val = (value_t*)memrina_alloc(mu_session, sizeof(value_t));
    if (!val) {
        return NULL;
    }

    val->valueType = VAR_NATIVE_CLOSURE;
    val->is_return = 0;
    val->refcount = 1;
    val->value.native.fn = i2c_reg_read_addr;
    val->value.native.ctx = ctx;

    return val;
}

void register_builtin(env_t* env, const char* name, builtin_fn fn) {
    value_t* val = (value_t*)memrina_alloc(mu_session, sizeof(value_t));
    if (!val) {
        return;
    }

    val->valueType = VAR_BUILTIN;
    val->is_return = 0;
    val->refcount = 1;
    val->value.builtin = fn;

    create_binding(env, (char*)name, strlen(name), val);
}
```

## src/console.c
```c
#include <zephyr/device.h>
#include <zephyr/drivers/console/uart_console.h>
#include <zephyr/drivers/uart.h>
#include <zephyr/kernel.h>

#include "mu_console.h"

#define RXBUF  4096
#define CTRL_C 0x03

BUILD_ASSERT((RXBUF & (RXBUF - 1)) == 0, "RXBUF must be a power of two");

static const struct device* const uart = DEVICE_DT_GET(DT_CHOSEN(zephyr_console));

static uint8_t rxbuf[RXBUF];
static volatile uint16_t i_get, i_put;
static volatile bool ctrl_c;
static volatile bool dropped;

static int rx_hook(uint8_t ch) {
    if (ch == CTRL_C) {
        ctrl_c = true;
        return 1;
    }

    uint16_t next = (i_put + 1) & (RXBUF - 1);

    if (next != i_get) {
        rxbuf[i_put] = ch;
        i_put = next;
    } else {
        // Ring full, byte lost, raise flag
        dropped = true;
    }

    return 1;
}

/* Hook console to callback */
int mu_console_init(void) {
    if (!device_is_ready(uart)) {
        return -ENODEV;
    }

    uart_console_in_debug_hook_install(rx_hook);
    // All nulls, only care about the callback
    uart_register_input(NULL, NULL, NULL);

    return 0;
}

int mu_getchar(void) {
    for (;;) {
        // Checked first so interrupts dont get queued behind the buffered inputs
        if (ctrl_c) {
            ctrl_c = false;
            return -1;
        }

        if (i_get != i_put) {
            break;
        }

        k_msleep(1);
    }

    int c = rxbuf[i_get];

    i_get = (i_get + 1) & (RXBUF - 1);

    return c;
}

/* Poll char out to uart */
void mu_putchar(char c) {
    uart_poll_out(uart, c);
}

/* Poll out string to uart */
void mu_write(const char* s, size_t len) {
    while (len--) {
        uart_poll_out(uart, *s++);
    }
}

/* Check if input was dropped */
bool mu_dropped(void) {
    bool was = dropped;

    dropped = false;

    return was;
}

/* Check if ctrl c */
bool mu_interrupted(void) {
    bool was = ctrl_c;

    ctrl_c = false;

    return was;
}
```

## src/memory-arena.c
```c
#include <stdint.h>
#include <stdlib.h>
#include <string.h>
#include "memory-arena.h"

// Round n up to the next multiple of align. align must be a power of two
static uintptr_t align_up(uintptr_t n, size_t align) {
    return (n + (align - 1)) & ~(uintptr_t)(align - 1);
}

Memrina* memrina_create(size_t size) {
    Memrina* memrina = malloc(sizeof(Memrina) + size);

    if (memrina == NULL) {
        return NULL;
    }
    // buffer begins after the header in the contiguous block
    uint8_t* buffer = (uint8_t*)memrina + sizeof(Memrina);

    memrina_init(memrina, buffer, size);

    return memrina;
}

void memrina_destroy(Memrina* arena) {
    if (arena == NULL) {
        return;
    }
    free(arena);
}

void memrina_init(Memrina* arena, uint8_t* buffer, size_t size) {
    arena->base = buffer;
    arena->size = size;
    arena->offset = 0;
}

void* memrina_alloc_aligned(Memrina* arena, size_t nbytes, size_t alignment) {
    if (arena == NULL || arena->base == NULL) {
        return NULL;
    }

    // check alignment is a power of two
    if (alignment == 0 || (alignment & (alignment - 1)) != 0) {
        return NULL;
    }

    // Align the address
    uintptr_t base = (uintptr_t)arena->base;
    uintptr_t aligned_addr = align_up(base + arena->offset, alignment);
    size_t aligned_offset = (size_t)(aligned_addr - base);

    if (aligned_offset > arena->size || nbytes > arena->size - aligned_offset) {
        return NULL; /* out of memory */
    }

    void* ptr = arena->base + aligned_offset;
    arena->offset = aligned_offset + nbytes;
    return ptr;
}

void* memrina_alloc(Memrina* arena, size_t nbytes) {
    return memrina_alloc_aligned(arena, nbytes, MEMRINA_DEFAULT_ALIGNMENT);
}

void* memrina_calloc(Memrina* arena, size_t nbytes) {
    void* ptr = memrina_alloc(arena, nbytes);
    if (ptr != NULL) {
        uint8_t* point = (uint8_t*)ptr;
        for (size_t i = 0; i < nbytes; i++) {
            point[i] = 0;
        }
    }
    return ptr;
}

void* memrina_alloc_array(Memrina* arena, size_t count, size_t size) {
    // Reject a count that would wrap when multiplied out
    if (size != 0 && count > (size_t)-1 / size) {
        return NULL;
    }

    return memrina_alloc(arena, count * size);
}

void* memrina_memdup(Memrina* arena, const void* src, size_t nbytes) {
    if (src == NULL) {
        return NULL;
    }

    void* ptr = memrina_alloc(arena, nbytes);

    if (ptr != NULL) {
        memcpy(ptr, src, nbytes);
    }

    return ptr;
}

char* memrina_strndup(Memrina* arena, const char* src, size_t len) {
    if (src == NULL) {
        return NULL;
    }

    char* ptr = memrina_alloc(arena, len + 1);

    if (ptr != NULL) {
        memcpy(ptr, src, len);
        ptr[len] = '\0';
    }

    return ptr;
}

Memrina_Checkpoint memrina_set_check(Memrina* arena) {
    Memrina_Checkpoint checkpoint;
    checkpoint.offset = (arena == NULL) ? 0 : arena->offset;
    return checkpoint;
}

void memrina_restore_check(Memrina* arena, Memrina_Checkpoint checkpoint) {
    if (arena == NULL) {
        return;
    }

    if (checkpoint.offset <= arena->offset) {
        arena->offset = checkpoint.offset;
    }
}

void memrina_clear(Memrina* arena) {
    if (arena == NULL) {
        return;
    }

    arena->offset = 0;
}

size_t memrina_usage(Memrina* arena) {
    return (arena == NULL) ? 0 : arena->offset;
}

size_t memrina_remaining(Memrina* arena) {
    return (arena == NULL) ? 0 : arena->size - arena->offset;
}
```
